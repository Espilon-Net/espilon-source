## espilon_bot/main/Kconfig
```kconfig
menu "Epsilon Bot Configuration"

################################################
# Device
################################################
config DEVICE_ID
    string "Device ID"
    default "ce4f626b"
    help
        Unique device identifier sent to the C2 server.

################################################
# Core Network
################################################
menu "Network"

choice NETWORK_MODE
    prompt "Connection Mode"
    default NETWORK_WIFI

config NETWORK_WIFI
    bool "WiFi"

config NETWORK_GPRS
    bool "GPRS"

endchoice

menu "WiFi Settings"
    depends on NETWORK_WIFI

config WIFI_SSID
    string "WiFi SSID"
    default "mywifi"

config WIFI_PASS
    string "WiFi Password"
    default ""

endmenu

menu "GPRS Settings"
    depends on NETWORK_GPRS

config GPRS_APN
    string "APN"
    default "sl2sfr"

endmenu

endmenu

################################################
# Server
################################################
menu "Server"

config SERVER_IP
    string "Server IP"
    default "192.168.1.100"

config SERVER_PORT
    int "Server Port"
    default 2626
    range 1 65535

endmenu

################################################
# Modules (Command Providers)
################################################
menu "Modules"

config MODULE_NETWORK
    bool "Network Commands"
    default y
    help
        ping, arp_scan, proxy, dos, etc.

config MODULE_RECON
    bool "Recon Commands"
    default n
    depends on NETWORK_WIFI
    help
        Network reconnaissance commands.

config MODULE_FAKEAP
    bool "Fake Access Point Commands"
    default n
    help
        Fake AP, captive portal, sniffer.

endmenu

################################################
# Recon Module Settings
################################################
menu "Recon Settings"
    depends on MODULE_RECON

config RECON_MODE_CAMERA
    bool "Enable Camera Reconnaissance"
    default n

config RECON_MODE_BLE_TRILAT
    bool "Enable BLE Trilateration Reconnaissance"
    default n

endmenu

################################################
# Security
################################################
menu "Security"

config CRYPTO_KEY
    string "ChaCha20 Key (32 bytes)"
    default "testde32chars00000000000000000000"

config CRYPTO_NONCE
    string "ChaCha20 Nonce (12 bytes)"
    default "noncenonceno"

endmenu

endmenu
```

## espilon_bot/sdkconfig.defaults
```kconfig
CONFIG_ID="f34592e0"
CONFIG_WIFI_SSID="Livebox-CC80"
CONFIG_WIFI_PASS="PqKXRmcprmeWChcfQD"
CONFIG_SERVER_IP="192.168.1.13"
CONFIG_SERVER_PORT=2626
CONFIG_MBEDTLS_CHACHA20_C=y
CONFIG_LWIP_IPV4_NAPT=y
CONFIG_LWIP_IPV4_NAPT_PORTMAP=y
CONFIG_LWIP_IP_FORWARD=y
CONFIG_LWIP_LOCAL_HOSTNAME="pixel-8-pro"
CONFIG_ENABLE_CAMERA=n

# Bluetooth configuration
CONFIG_BT_ENABLED=y
CONFIG_BT_BLUEDROID_ENABLED=y
CONFIG_BT_BLE_ENABLED=y
```
